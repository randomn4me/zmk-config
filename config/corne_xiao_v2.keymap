// Miryoku configuration
#include "../miryoku_zmk/miryoku/custom_config.h"
#include "../miryoku_zmk/miryoku/mapping/42/corne.h"
#include "../miryoku_zmk/miryoku/miryoku.dtsi"

/ {
    combos {
        compatible = "zmk,combos";

        combo_studio_unlock {
            timeout-ms = <50>;
            key-positions = <0 1>;
            bindings = <&studio_unlock>;
        };
    };
};

